#include <SPI.h>
#include <mcp23s17.h>   // needed!
#include <T6963_SPI.h>
#include "fonts/Times_New_Roman__14.h"

#if (defined(__AVR_ATmega1280__) || defined(__AVR_ATmega1281__) || defined(__AVR_ATmega2560__) || defined(__AVR_ATmega2561__))      //--- Arduino Mega ---
T6963_SPI lcd(53,0x20,1);//53,0x20
#else	
T6963_SPI lcd(10,0x20,1);//10,0x20
#endif





//Arduino Image1
#define ArduinoHEIGHT 	64	//Height in pixels
#define ArduinoBYTEWIDTH 	16	//Width in bytes

//Arduino Image2
#define Arduino1HEIGHT 	64	//Height in pixels
#define Arduino1BYTEWIDTH 	17	//Width in bytes

static unsigned char PROGMEM Arduinobmp[]= { //AVR-GCC, WinAVR
  0x00,0x00,0x00,0x00,0x00,0x00,0x00,0x00,0x00,0x00,0x00,0x00,0x00,0x00,0x00,0x00,
  0x00,0x00,0x00,0x0F,0x3C,0x00,0x00,0x00,0x00,0x00,0x00,0x3F,0x20,0x00,0x00,0x00,
  0x00,0x00,0x07,0x3F,0x3F,0x30,0x00,0x00,0x00,0x00,0x0F,0x3F,0x3F,0x00,0x00,0x00,
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  0x00,0x00,0x00,0x00,0x00,0x00,0x00,0x00,0x00,0x00,0x00,0x00,0x00,0x00,0x00,0x00
};

static unsigned char PROGMEM Arduino1bmp[]= { //AVR-GCC, WinAVR
  0x00,0x00,0x00,0x00,0x00,0x00,0x00,0x00,0x00,0x00,0x00,0x00,0x00,0x00,0x00,0x00,0x00,
  0x00,0x00,0x00,0x00,0x00,0x00,0x00,0x00,0x00,0x00,0x00,0x00,0x00,0x00,0x00,0x00,0x00,
  0x00,0x00,0x00,0x00,0x00,0x00,0x00,0x00,0x00,0x00,0x00,0x00,0x00,0x00,0x00,0x00,0x00,
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  0x00,0x00,0x00,0x00,0x00,0x00,0x00,0x00,0x00,0x00,0x00,0x00,0x00,0x00,0x00,0x00,0x00
};



void pixelDemo(){
  for(byte _b = 0;_b<240;_b++){
    lcd.drawPixel(_b,_b >> 1,1);
  }
  delay(1000);
}

void textDemo1(){
  lcd.clearGraphic();
  for(byte _b=0;_b<128;_b +=8){
    lcd.setCursor(_b/8,_b/8);
    lcd.print("Hello World");
  }
  delay(1000);
}

void drawLineDemo(){
  lcd.clearGraphic();
  lcd.drawLine(0,0,239,127,1);
  delay(1000);

  lcd.drawLine(239,0,0,127,1);
  delay(1000);
  lcd.clearGraphic();
  lcd.clearText();
  for(int x=0;x<128;x+=4){
    lcd.drawLine(0,x,x<<1,127,1);
    delay(10);
  }
  delay(1000);
}

void drawCircleDemo(){
  lcd.drawCircle(80,24,16,1);
  lcd.drawCircle(90,26,16,1);
  lcd.drawCircle(100,28,16,1);
  lcd.drawCircle(110,30,16,1);
  lcd.drawCircle(120,32,16,1);
  lcd.drawCircle(130,34,16,1);
  lcd.drawCircle(140,36,16,1);
  lcd.drawCircle(150,38,16,1);
  lcd.drawCircle(160,40,16,1);
  delay(1000);
}

void textModeDemo(){
  const char* textmessage[4] = { 
    "           * Normal Display *           ", 
    "          * Reverse Display *          ", 
    "      * Blink of normal Display *      ",
    "      * Blink of reverse Display *      "  };
  const uint8_t textmode[4] = {
    NORMAL,REVERSE,NBLINK,RBLINK  };
  lcd.clearGraphic();
  lcd.clearText();
  // Text Attribute Mode by T6963C
  //Set Text attributes in Text Mode,Graphic Off
  lcd.setMode(TEXT,INT);//NORMAL,XOR,AND,TEXT Attribute Mode,INT=Intern CGram,EXT=Extern CGram

  for(int i = 0;i<4;i++)
  { 
    lcd.setCursor(0,0);
    lcd.print("TEXT DEMO Textattribute Set by T6963C");
    lcd.setCursor(0,2);
    lcd.print(textmessage[i]);
    lcd.setTextAttrMode(textmode[i]); // NORMAL=Normal display REVERSE=Reverse display INHIBIT=Inhibit display NBLINK=Blink of normal display RBLINK=Blink of reverse display IBLINK=Blink of inhibit display (TEXT ONLY)

    for (int x = 0; x <= 126; x++)
    {
      lcd.setCursor(x,4);			
      lcd.write(x+33);
      lcd.setCursor(x,9);			
      lcd.write(x+33);
      delay(50);
    }
    lcd.clearText();
  }
  lcd.setMode(NORMAL);//0=Normal X=Xor A=And T=Text Attribute Mode  ,  I=Intern CGram ,E=Extern CGram
  lcd.clearGraphic();
}

void animationDemo(){
  // Animated Image
  /*
  lcd.setMode(XOR); //Mode Set for Reverse Text
   for(int i = 0;i<10;i++)
   {
   lcd.drawFastRect(0,0,8,40,0b111111);                  // drawrectbyte(x, y, height, bytewidth,pattern) // x,y = Start Position, Height in Pixel, Widht in Byte (6x8Font =6 Pixel 8x8Font = 8 Pixel, Fill pattern in byte Example:0b10101010  
   lcd.setCursor(1,0);
   lcd.print("LCD GRAPHIC DISPLAY 240x64 with T6963C");
   lcd.drawAnim( 62, 50, animdemo, 24, pictureHEIGHT, pictureBYTEWIDTH);
   }  
   */
}

void bitMapDemo(){
  lcd.clearGraphic();
  lcd.clearText();

  // Arduino Image 1 + 2
  lcd.drawBitmap(72, 0, Arduino1bmp ,Arduino1HEIGHT, Arduino1BYTEWIDTH );	//x,y = Position, Picturename (not Filename), Height in Pixel, Widht in Byte
  lcd.drawBitmap(72, 60, Arduinobmp ,ArduinoHEIGHT, ArduinoBYTEWIDTH );	//x,y = Position, Picturename (not Filename), Height in Pixel, Widht in Byte
  delay(3000);
  lcd.clearGraphic();
}

void externalFontDemo(){
  lcd.setMode(NORMAL);//Switch to Normal Mode
  lcd.clearGraphic();
  lcd.clearText();
  //Font Demo
  lcd.glcd_print2_P(3, 0, "Font Times New Roman14", &Times_New_Roman__14, 0);
  lcd.glcd_print2_P(60, 40, "Hello World", &Times_New_Roman__14, 1);
  lcd.glcd_print2_P(60, 60, "Hello World", &Times_New_Roman__14, 0);
  lcd.glcd_print2_P(60, 80, "Hello World", &Times_New_Roman__14, 1);
  lcd.glcd_print2_P(60, 100, "Hello World", &Times_New_Roman__14, 0);
}

void filledBoxDemo(){
  // Filled Box Speed Demo  

  lcd.setCursor(0,0);
  lcd.print("       Speed Demo with filled Box       ");
  lcd.setCursor(1,14);   
  lcd.print("    write Byte         write Pixel");
  lcd.drawRect(4,10,112,87,1);                            //Position Horizontal, Position Vertikal, Länge, Höhe des Rechteck
  lcd.drawFastRect(10,12,83,18,0b111111);                  // drawrectbyte(x, y, height, bytewidth, pattern) // x,y = Start Position, Height in Pixel, Widht in Byte (6x8Font =6 Bits 8x8Font = 8 Bits, Fill pattern in byte Example:0b10101010  
  lcd.drawRect(124,10,112,87,1);
  lcd.drawFillRect(126,12,233,94,1);                           //X,Y,X1,Y1
  delay(100);
  lcd.drawFastRect(10,12,83,18,0b00000000);//Clear Box byte
  lcd.drawFastRect(126,12,83,18,0b00000000);//Clear Box Pixel

}

void bigDemo(){
  pixelDemo();
  textDemo1();
  drawLineDemo();
  drawCircleDemo();
  textModeDemo();
  filledBoxDemo();
  bitMapDemo();
  //animationDemo();
  //externalFontDemo();
  delay(4000);
  lcd.clearGraphic();
}


void setup() {
  //Serial.begin(115200);
  lcd.begin(240,128,T6963_6x8DOTS,32);//240,128,T6963_6x8DOTS,32
  lcd.setBacklight(1);

}

void loop() {
  bigDemo();
}
